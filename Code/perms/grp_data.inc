const char* a_involution_str = "213456";
const char* b_involution_str = "214365";

byte a_involution[6];
byte b_involution[6];

// G=S_6, P1= C_G(a)

// P1_str
const char* P1_str[48] = {

  // 123456
  // ______

  // e (1)
    "123456",      // (1)

  // order 4 (6)
    "124563",     // (3 4 5 6)
    "126345",     // (3 6 5 4)
    "125364",     // (3 5 6 4)
    "124635",     // (3 4 6 5)
    "126534",     // (3 6 4 5)
    "125643",     // (3 5 4 6)

  // order 3 (8)
    "124536",     // (345)
    "125346",     // (354)
    "123564",     // (456)
    "123645",     // (465)
    "125463",     // (356)
    "126435",     // (365)
    "124653",     // (346)
    "126354",     // (364)

  // order 2 (9)
    "124356",      // (34)
    "123465",      // (56)
    "124365",      // (34)(56)
    "123546",      // (45)
    "126453",      // (36)
    "126543",      // (45)(36)
    "125436",      // (35)
    "123654",      // (46)
    "125634",      // (46) (35)

  // order 2
    "213456",     // (12)

  // order 4 (6)
    "214563",     // (1 2) (3 4 5 6)
    "216345",     // (1 2) (3 6 5 4)
    "215364",     // (1 2) (3 5 6 4)
    "214635",     // (1 2) (3 4 6 5)
    "216534",     // (1 2) (3 6 4 5)
    "215364",     // (1 2) (3 5 6 4)

  // order 6 (8)
    "214536",      // (1 2) (345)
    "215346",      // (1 2) (354)
    "213564",      // (1 2) (456)
    "213645",      // (1 2) (465)
    "215463",      // (1 2) (356)
    "216435",      // (1 2) (365)
    "214653",      // (1 2) (346)
    "216354",      // (1 2) (364)

  // order 2 (9)
    "214356",      // (1 2) (34)
    "213465",      // (1 2) (56)
    "214365",      // (1 2) (34)(56)
    "213546",      // (1 2) (45)
    "216453",      // (1 2) (36)
    "216543",      // (1 2) (45)(36)
    "215436",      // (1 2) (35)
    "213654",      // (1 2) (46)
    "215634",      // (1 2) (46) (35)
  };

byte P1_perms[6 * 48];

// P1_coset_reps
const char* P1_coset_reps_str[15] ={
  // 123456
  // ------
    "123456", // e
    "321456", // (13)
    "423156", // (14)
    "523416", // (15)
    "623451", // (16)
    "132456", // (23)
    "143256", // (24)
    "153426", // (25)
    "163452", // (26)
    "341256", // (13)(24)
    "351426", // (13)(25)
    "361452", // (13)(26)
    "453126", // (14)(25)
    "463152", // (14)(26)
    "564312", // (15)(26)(34)
};
byte P1_coset_reps[6 * 15];


// P2_str
// G=S_6, P2= C_G(b)
const char* P2_str[48] = {
  // 123456
  // _____

    "123456", // e
    "213456", // (12)
    "124356", // (34)
    "123465", // (56)
    "214356", // (12)(34)
    "213465", // (12)(56)
    "124365", // (34)(56)
    "214365", // (12)(34)(56)
    "345612", // (135)(246)
    "345621", // (1  3  5  2  4  6)

    "435612", // (1  4  6  2  3  5)
    "346512", // (1  3  6  2  4  5)
    "435621", // (1  4  6)(2  3  5)
    "346521", // (1  3  6)(2  4  5)
    "436512", // (1  4  5)(2  3  6)
    "436521", // (1  4  5  2  3  6)
    "561234", // (1  5  3)(2  6  4)
    "562134", // (1  5  3  2  6  4)
    "561243", // (1  5  4  2  6  3)
    "651234", // (1  6  4  2  5  3)
    "562143", // (1  5  4)(2  6  3)
    "652134", // (1  6  4)(2  5  3)
    "651243", // (1  6  3)(2  5  4)
    "652143", // (1  6  3  2  5  4)
    "432156", // (1  4)(2  3)
    "431256", // (1  4  2  3)
    "342156", // (1  3  2  4)
    "432165", // (1  4)(2  3)(5  6)
    "341256", // (1  3)(2  4)
    "431265", // (1  4  2  3)(5  6)
    "342165", // (1  3  2  4)(5  6)
    "341265", // (1  3)(2  4)(5  6)
    "654312", // (1  6  2  5)(3  4)
    "654321", // (1  6)(2  5)(3  4)
    "653412", // (1  6  2  5)
    "564312", // (1  5)(2  6)(3  4)
    "653421", // (1  6)(2  5)
    "564321", // (1  5  2  6)(3  4)
    "563412", // (1  5)(2  6)
    "563421", // (1  5  2  6)
    "216534", // (1  2)(3  6  4  5)
    "126534", // (3  6  4  5)
    "216543", // (1  2)(3  6)(4  5)
    "215634", // (1  2)(3  5)(4  6)
    "126543", // (3  6)(4  5)
    "125634", // (3  5)(4  6)
    "215643", // (1  2)(3  5  4  6)
    "125643", // (3  5  4  6)
};
byte P2_perms[6 * 48];


// P2_coset_reps
const char* P2_coset_reps_str[15] = {
  "123456", // e
  "321456", // (13)
  "423156", // (14)
  "523416", // (15)
  "623451", // (16)
  "125436", // (35)
  "123546", // (45)
  "351426", // (13)(25)
  "361452", // (13)(26)
  "321546", // (13)(45)
  "132546", // (23)(45)
  "132654", // (23)(46)
  "123563", // (456)
  "234561", // (123456)
  "423651", // (146)
};
byte P2_coset_reps[6 * 15];

const char* eight_str[8] = {
    "123456", // e
    "213456", // (12)
    "124356", // (34)
    "123465", // (56)
    "214356", // (12)(34)
    "213465", // (12)(56)
    "124365", // (34)(56)
    "214365", // (12)(34)(56)
};
const char* three_str[8] = {
    "123456", // e
    "345612", // (135)(246)
    "561234", // (153)(264)
};

byte eight[6 * 8];
byte three[6 * 3];
byte twenty_four[6 * 24];
byte fourty_eight[6 * 48];

byte P1_coset_union[6 * 720];
byte P2_coset_union[6 * 720];

